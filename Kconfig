## Kconfig
```kconfig
#
#	Library KConfig
#
############################################################

choice
	prompt "Platform"
	default OPENTHREAD_PLATFORM_POSIX

	config OPENTHREAD_PLATFORM_POSIX
		bool "poxis"

	config OPENTHREAD_PLATFORM_CC2538
		bool "cc2538"

endchoice # Platform

config OPENTHREAD_PLATFORM
	string
	default "poxis"		if OPENTHREAD_PLATFORM_POSIX
	default "cc2538"	if OPENTHREAD_PLATFORM_CC2538

choice
	prompt "Application"
	default OPENTHREAD_APPLICATION_CLI

	config OPENTHREAD_APPLICATION_CLI
		bool "cli"

	config OPENTHREAD_APPLICATION_NCP
		bool "ncp"

endchoice # Application

config OPENTHREAD_APPLICATION
	string
	default "cli"		if OPENTHREAD_APPLICATION_CLI
	default "ncp"		if OPENTHREAD_APPLICATION_NCP
```

## src/Kconfig
```kconfig
#
#	Libraries/openthread/src KConfig
#
############################################################

comment "OpenThread Network (OT)"

choice
	prompt "Interface Type"
	default OT_IFACE_NONE

	config OT_IFACE_NONE
		bool "none"
	config OT_IFACE_CLI
		bool "Client Interfac (CLI)"
	config OT_IFACE_NCP
		bool "Network Co-Processor (NCP)"
endchoice # Type

config OT_IFACE_TYPE
	string
	option ot_iface_type
	default "cli"		if OT_IFACE_CLI
	default "ncp"		if OT_IFACE_NCP
	default "none"		if OT_IFACE_NONE

config OT_DIAG
	bool "Diagnostics (diag)"
	default n

config OT_MULTIPLE_INSTANCE
	bool "Multiple instances"
	default n

menu "Core"
	source "$LIBRARY_DIR/stack/openthread/src/core/Kconfig"
endmenu
```

## src/core/Kconfig
```kconfig
#
#	Libraries/openthread/src/core KConfig
#
############################################################

comment "OT/Core"

config OPENTHREAD_ENABLE_COMMISSIONER
	bool "Enable commissioner"
	default y

config OPENTHREAD_ENABLE_DTLS
	bool "Enable DTLS"
	default n

config OPENTHREAD_ENABLE_JOINER
	bool "Enable joiner"
	default y
```
